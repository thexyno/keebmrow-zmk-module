## boards/shields/keebmrow/pim447/Kconfig
```kconfig
menuconfig PIM447
    bool "Enable PIM447 Trackball"
    default n
    help
      Enable support for the PIM447 trackball sensor.

if PIM447

config PIM447_CPI
    int "PIM447 CPI"
    default 3000
    help
      Sets the Counts Per Inch (CPI) for the PIM447 trackball sensor.

config PIM447_CPI_DIVIDOR
    int "PIM447 CPI Dividor"
    default 4
    help
      Sets the CPI Dividor for the PIM447 trackball sensor.

config PIM447_ORIENTATION_90
    bool "PIM447 Orientation 90"
    default y
    help
      Set the PIM447 trackball orientation to 90 degrees.

config PIM447_SNIPE_CPI
    int "PIM447 Snipe CPI"
    default 800
    help
      Sets the Snipe CPI for the PIM447 trackball sensor.

config PIM447_SNIPE_CPI_DIVIDOR
    int "PIM447 Snipe CPI Dividor"
    default 4
    help
      Sets the Snipe CPI Dividor for the PIM447 trackball sensor.

config PIM447_SCROLL_TICK
    int "PIM447 Scroll Tick"
    default 21
    help
      Sets the Scroll Tick for the PIM447 trackball sensor.

config PIM447_INVERT_X
    bool "Invert X Axis"
    default y
    help
      Invert the X axis of the PIM447 trackball sensor.

config PIM447_INVERT_SCROLL_Y
    bool "Invert Scroll Y Axis"
    default n
    help
      Invert the Scroll Y axis of the PIM447 trackball sensor.

config PIM447_RUN_DOWNSHIFT_TIME_MS
    int "PIM447 Run Downshift Time (ms)"
    default 3264
    help
      Sets the run downshift time in milliseconds for the PIM447 trackball sensor.

config PIM447_REST1_SAMPLE_TIME_MS
    int "PIM447 Rest1 Sample Time (ms)"
    default 20
    help
      Sets the rest1 sample time in milliseconds for the PIM447 trackball sensor.

config PIM447_REST1_DOWNSHIFT_TIME_MS
    int "PIM447 Rest1 Downshift Time (ms)"
    default 9600
    help
      Sets the rest1 downshift time in milliseconds for the PIM447 trackball sensor.

config PIM447_REST2_SAMPLE_TIME_MS
    int "PIM447 Rest2 Sample Time (ms)"
    default 0
    help
      Sets the rest2 sample time in milliseconds for the PIM447 trackball sensor.

config PIM447_REST2_DOWNSHIFT_TIME_MS
    int "PIM447 Rest2 Downshift Time (ms)"
    default 0
    help
      Sets the rest2 downshift time in milliseconds for the PIM447 trackball sensor.

config PIM447_REST3_SAMPLE_TIME_MS
    int "PIM447 Rest3 Sample Time (ms)"
    default 0
    help
      Sets the rest3 sample time in milliseconds for the PIM447 trackball sensor.

config PIM447_REST3_DOWNSHIFT_TIME_MS
    int "PIM447 Rest3 Downshift Time (ms)"
    default 0
    help
      Sets the rest3 downshift time in milliseconds for the PIM447 trackball sensor.

config PIM447_FORCE_AWAKE
    bool "Force Awake"
    default n
    help
      Force the PIM447 trackball sensor to remain awake.

config PIM447_POLLING_RATE_125_SW
    bool "Polling Rate 125 SW"
    default y
    help
      Sets the polling rate to 125 Hz for the PIM447 trackball sensor.

config PIM447_SMART_ALGORITHM
    bool "Smart Algorithm"
    default n
    help
      Enable the smart algorithm for the PIM447 trackball sensor.

endif # PIM447
```

## config/boards/shields/keebmrow/Kconfig.defconfig
```kconfig
if SHIELD_KEEBMROW_RIGHT

config ZMK_KEYBOARD_NAME
    default "Keebmrow"

config ZMK_SPLIT_ROLE_CENTRAL
    default y

endif

if SHIELD_KEEBMROW_LEFT || SHIELD_KEEBMROW_RIGHT

config ZMK_SPLIT
    default y

endif
```

## config/boards/shields/keebmrow/Kconfig.shield
```kconfig
config SHIELD_KEEBMROW_LEFT
    def_bool $(shields_list_contains,keebmrow_left)

config SHIELD_KEEBMROW_RIGHT
    def_bool $(shields_list_contains,keebmrow_right)
```

## config/west.yml
```yaml
manifest:
  # remotes:
  #   - name: zmkfirmware
  #     url-base: https://github.com/zmkfirmware
  #   - name: pim447
  #     url-base: https://github.com/cdc-mkb
  #   # Additional modules containing boards/shields/custom code can be listed here as well
  #   # See https://docs.zephyrproject.org/3.2.0/develop/west/manifest.html#projects
  # projects:
  #   - name: zmk
  #     remote: zmkfirmware
  #     revision: main
  #     import: app/west.yml
  #   - name: mouse-pim447
  #     remote: pim447
  #     repo-path: zmk
  #     revision: mouse-pim447
  remotes:
    - name: zmkfirmware
      url-base: https://github.com/zmkfirmware
    - name: jgreel
      url-base: https://github.com/jgreel
  projects:
    - name: zmk
      remote: jgreel
      revision: devel-mouse-pim447
      import: app/west.yml
  self:
    path: config
```
