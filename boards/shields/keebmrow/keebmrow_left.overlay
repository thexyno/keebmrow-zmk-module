/*
 * Copyright (c) 2020 Pete Johanson
 *
 * SPDX-License-Identifier: MIT
 */

#include "keebmrow.dtsi"

&default_transform {
    col-offset = <0>;
};

&left_encoder {
    status = "okay";
};

// &five_column_transform {
//     col-offset = <6>;
// };

&kscan0 {
    col-gpios
        = <&pro_micro 1 (GPIO_ACTIVE_HIGH)>
        , <&pro_micro 0 (GPIO_ACTIVE_HIGH)>
        , <&pro_micro 2 (GPIO_ACTIVE_HIGH)>
        , <&pro_micro 3 (GPIO_ACTIVE_HIGH)>
        , <&pro_micro 4 (GPIO_ACTIVE_HIGH)>
        , <&pro_micro 5 (GPIO_ACTIVE_HIGH)>
        ;
        row-gpios
            = <&pro_micro 15 (GPIO_ACTIVE_HIGH | GPIO_PULL_DOWN)>
            , <&pro_micro 14 (GPIO_ACTIVE_HIGH | GPIO_PULL_DOWN)>
            , <&pro_micro 16 (GPIO_ACTIVE_HIGH | GPIO_PULL_DOWN)>
            , <&pro_micro 10 (GPIO_ACTIVE_HIGH | GPIO_PULL_DOWN)>
            ;
};
